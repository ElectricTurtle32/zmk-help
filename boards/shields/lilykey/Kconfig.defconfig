## boards/shields/lilykey/Kconfig.defconfig
```kconfig
if SHIELD_LILYKEY_RIGHT

config ZMK_KEYBOARD_NAME
    default "lilykey"

config ZMK_SPLIT_ROLE_CENTRAL
    default y

endif # SHIELD_LILYKEY_RIGHT

if SHIELD_LILYKEY_LEFT || SHIELD_LILYKEY_RIGHT

config ZMK_SPLIT
    default y

endif # SHIELD_LILYKEY_LEFT || SHIELD_LILYKEY_RIGHT
```

## boards/shields/lilykey/Kconfig.shield
```kconfig
config SHIELD_LILYKEY_LEFT
    def_bool $(shields_list_contains,lilykey_left)

config SHIELD_LILYKEY_RIGHT
    def_bool $(shields_list_contains,lilykey_right)
```
